/*
 * SPDX-License-Identifier: Apache-2.0
 *
 * Copyright (c) 2024 Realtek Semiconductor Corporation, SIBG-SD7
 *
 */

/dts-v1/;
#include <realtek/ec/rts5918.dtsi>
#include <realtek/ec/rts5918-pinctrl.dtsi>
#include <zephyr/dt-bindings/gpio/gpio.h>

/ {
	model = "Realtek RTS5918 Evaluation Board";
	compatible = "realtek,rts5918-evb";

	chosen {
		zephyr,sram = &sram0;
		zephyr,console = &uart0;
		zephyr,shell-uart = &uart0;
		zephyr,flash = &flash0;
	};
};

&uart0 {
	status = "okay";
	current-speed = <115200>;
};

&uart0_wrapper {
	status = "okay";
	pinctrl-0 = <&uart_rx_gpio012 &uart_tx_gpio013>;
	pinctrl-names = "default";
};