## boards/realtek/rts5918_evb/board.yml
```yaml
board:
  name: rts5918_evb
  full_name: RTS5918 Evaluation Board
  vendor: realtek
  socs:
  - name: rts5918
```

## boards/realtek/rts5918_evb/rts5918_evb_defconfig
```kconfig
# SPDX-License-Identifier: Apache-2.0
#
# Copyright (c) 2024 Realtek Semiconductor Corporation, SIBG-SD7
#

# Enable RTS5918 image tool
#CONFIG_REALTEK_RTS5918_BOOTROM_HEADER=y

# Serial Driver
CONFIG_SERIAL=y
CONFIG_UART_NS16550=y
#CONFIG_UART_INTERRUPT_DRIVEN=y

# Console
CONFIG_CONSOLE=y
CONFIG_UART_CONSOLE=y

# Enable GPIO
CONFIG_GPIO=y
```

## boards/realtek/rts5919_evb/board.yml
```yaml
board:
  name: rts5919_evb
  full_name: rts5919 Evaluation Board
  vendor: realtek
  socs:
  - name: rts5919
```

## drivers/clock_control/Kconfig.rts5919
```kconfig
# SPDX-License-Identifier: Apache-2.0
#
# Copyright (c) 2024 Realtek Semiconductor Corporation, SIBG-SD7
#

config CLOCK_CONTROL_RTS5919_SCCON
	bool "Realtek RTS5919 system clock controller driver"
	depends on SOC_SERIES_RTS5919
	default y if DT_HAS_REALTEK_RTS5919_SCCON_ENABLED
	help
	  Enable support for RTS5919 system clock controller driver
```

## soc/realtek/ec/rts5919/Kconfig.defconfig.series
```kconfig
# SPDX-License-Identifier: Apache-2.0
#
# Copyright (c) 2024 Realtek Semiconductor Corporation, SIBG-SD7
#

if SOC_SERIES_RTS5919

config NUM_IRQS
	default 240

rsource "Kconfig.defconfig.rts5919"

endif # SOC_SERIES_RTS5919
```

## soc/realtek/ec/rts5919/Kconfig.soc
```kconfig
# SPDX-License-Identifier: Apache-2.0
#
# Copyright (c) 2024 Realtek Semiconductor Corporation, SIBG-SD7
#

config SOC_SERIES_RTS5919
	bool
	select SOC_FAMILY_REALTEK_EC
	help
	  Enable support for REALTEK EC MCU series

config SOC_SERIES
	default "rts5919" if SOC_SERIES_RTS5919

config SOC_RTS5919
	bool
	select SOC_SERIES_RTS5919

config SOC
	default "rts5919" if SOC_RTS5919
```
